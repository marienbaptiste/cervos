## CMakeLists.txt
```
cmake_minimum_required(VERSION 3.20.0)
find_package(Zephyr REQUIRED HINTS $ENV{ZEPHYR_BASE})
project(cervos_dongle)

# --- App sources ---
target_sources(app PRIVATE
    src/main.c
    src/audio_buffer.c
    src/usb_audio_capture.c
    src/ble_l2cap_stream.c
    src/lc3_encoder.c
)

# --- LC3 codec library (google/liblc3) ---
set(LC3_DIR ${CMAKE_CURRENT_SOURCE_DIR}/lib/liblc3)

target_sources(app PRIVATE
    ${LC3_DIR}/src/attdet.c
    ${LC3_DIR}/src/bits.c
    ${LC3_DIR}/src/bwdet.c
    ${LC3_DIR}/src/energy.c
    ${LC3_DIR}/src/lc3.c
    ${LC3_DIR}/src/ltpf.c
    ${LC3_DIR}/src/mdct.c
    ${LC3_DIR}/src/plc.c
    ${LC3_DIR}/src/sns.c
    ${LC3_DIR}/src/spec.c
    ${LC3_DIR}/src/tables.c
    ${LC3_DIR}/src/tns.c
)

target_include_directories(app PRIVATE
    ${LC3_DIR}/include
)

# Disable ARM DSP optimizations — they produce bitstream incompatible
# with the generic C path used on the phone (AArch64).
# Force generic C code path by undefining __arm__.
target_compile_definitions(app PRIVATE
    LC3_DISABLE_ARM
)

# Override the ARM detection in liblc3 sources
set_source_files_properties(
    ${LC3_DIR}/src/ltpf.c
    ${LC3_DIR}/src/mdct.c
    ${LC3_DIR}/src/sns.c
    ${LC3_DIR}/src/spec.c
    PROPERTIES COMPILE_FLAGS "-U__arm__ -U__ARM_ARCH -std=c11"
)

target_compile_options(app PRIVATE -O2)
target_link_libraries(app PRIVATE -lm)
```

## west.yml
```
manifest:
  remotes:
    - name: zephyrproject-rtos
      url-base: https://github.com/zephyrproject-rtos

  projects:
    - name: zephyr
      remote: zephyrproject-rtos
      revision: v3.7.0
      import:
        name-allowlist:
          - cmsis
          - hal_nordic
          - tinycrypt

  self:
    path: firmware
```

## prj.conf
```kconfig
# Cervos nRF52840 Dongle
# USB Audio Class speaker + BLE L2CAP CoC audio streamer (LC3 codec)

# ---- USB Device ----
CONFIG_USB_DEVICE_STACK=y
CONFIG_USB_DEVICE_PRODUCT="Cervos Meeting Bridge"
CONFIG_USB_DEVICE_MANUFACTURER="Cervos"
CONFIG_USB_DEVICE_VID=0x1209
CONFIG_USB_DEVICE_PID=0xCE57
CONFIG_USB_DEVICE_INITIALIZE_AT_BOOT=n

# ---- USB Audio Class ----
CONFIG_USB_DEVICE_AUDIO=y

# ---- Net buf (required for USB audio + L2CAP) ----
CONFIG_NET_BUF=y

# ---- Bluetooth ----
CONFIG_BT=y
CONFIG_BT_PERIPHERAL=y
CONFIG_BT_DEVICE_NAME="Cervos Meeting Bridge"
CONFIG_BT_DEVICE_APPEARANCE=833

# GATT config
CONFIG_BT_GATT_DYNAMIC_DB=y
CONFIG_BT_ATT_PREPARE_COUNT=2

# Data Length Extension — fit 207-byte LC3 packets in single notification
CONFIG_BT_L2CAP_TX_MTU=247
CONFIG_BT_BUF_ACL_TX_SIZE=251
CONFIG_BT_BUF_ACL_RX_SIZE=251
CONFIG_BT_CTLR_DATA_LENGTH_MAX=251
CONFIG_BT_USER_DATA_LEN_UPDATE=y

# TX buffer count — enough for queued notifications
CONFIG_BT_BUF_ACL_TX_COUNT=8
CONFIG_BT_CONN_TX_MAX=8

# ---- Settings (NVS for persistent config) ----
CONFIG_SETTINGS=y
CONFIG_SETTINGS_NVS=y
CONFIG_NVS=y
CONFIG_FLASH=y
CONFIG_FLASH_MAP=y
CONFIG_FLASH_PAGE_LAYOUT=y

# ---- Reboot support ----
CONFIG_REBOOT=y

# ---- Logging ----
CONFIG_LOG=y
CONFIG_LOG_DEFAULT_LEVEL=3
CONFIG_USB_DEVICE_LOG_LEVEL_WRN=y

# ---- FPU (required for LC3 float operations) ----
CONFIG_FPU=y
CONFIG_FPU_SHARING=y

# ---- C library (newlib for LC3 math) ----
CONFIG_NEWLIB_LIBC=y

# ---- System (stack sized for LC3 stereo encoding) ----
CONFIG_HEAP_MEM_POOL_SIZE=16384
CONFIG_MAIN_STACK_SIZE=32768
CONFIG_SYSTEM_WORKQUEUE_STACK_SIZE=2048
```

## app.overlay
```dts
/*
 * Devicetree overlay for nRF52840 Dongle — Cervos Meeting Bridge
 * USB Audio Class. NVS uses the board's built-in storage_partition.
 */

&zephyr_udc0 {
	status = "okay";

	hp_0 {
		compatible = "usb-audio-hp";
		feature-mute;
		channel-l;
		channel-r;
		resolution = <16>;
		sample-rate-hz = <48000>;

		feature-volume;
		volume-max = <0x0500>;
		volume-min = <0xBA00>;
		volume-res = <0x100>;
	};
	mic_0 {
		compatible = "usb-audio-mic";
		feature-mute;
		channel-l;
		channel-r;
		resolution = <16>;
		sample-rate-hz = <48000>;
	};
};
```

## src/main.c
```c
/*
 * Cervos — nRF52840 Dongle Main
 *
 * Pipeline: USB 48kHz stereo → downsample 24kHz mono → LC3 encode → BLE GATT notify
 * Falls back to raw PCM if LC3 init fails.
 */

#include <zephyr/kernel.h>
#include <zephyr/logging/log.h>

#include "audio_buffer.h"
#include "lc3_encoder.h"

LOG_MODULE_REGISTER(main, LOG_LEVEL_INF);

extern int usb_audio_init(void);
extern int ble_audio_init(void);
extern int ble_audio_send_lc3(const uint8_t *data, size_t len);

static bool lc3_ok = false;

int main(void)
{
    int ret;

    LOG_INF("Cervos nRF52840 dongle starting...");

    audio_buffer_init(&audio_ring_buffer);

    ret = ble_audio_init();
    if (ret) {
        LOG_ERR("BLE init failed: %d", ret);
        return ret;
    }

    ret = usb_audio_init();
    if (ret) {
        LOG_WRN("USB init issue: %d", ret);
    }

    /* LC3 encoder — non-fatal, fall back to raw PCM */
    ret = lc3_enc_init();
    if (ret == 0) {
        lc3_ok = true;
    } else {
        LOG_WRN("LC3 init failed: %d — raw PCM fallback", ret);
    }

    LOG_INF("Dongle ready — codec: %s",
            lc3_ok ? "LC3 24kHz mono 48kbps" : "raw PCM 24kHz mono");

    static int16_t pcm_frame[AUDIO_FRAME_SAMPLES];
    static uint8_t lc3_packet[LC3_MAX_PACKET];

    while (1) {
        k_sem_take(&audio_ring_buffer.frame_ready, K_FOREVER);

        if (audio_buffer_read(&audio_ring_buffer, pcm_frame, AUDIO_FRAME_SAMPLES) == 0) {
            if (lc3_ok) {
                int encoded = lc3_enc_encode(pcm_frame, lc3_packet,
                                             sizeof(lc3_packet));
                if (encoded > 0) {
                    ble_audio_send_lc3(lc3_packet, encoded);
                }
            } else {
                /* Raw PCM fallback in 240-byte chunks */
                const uint8_t *data = (const uint8_t *)pcm_frame;
                size_t total = AUDIO_FRAME_BYTES;
                size_t offset = 0;
                while (offset < total) {
                    size_t len = total - offset;
                    if (len > 240) len = 240;
                    ble_audio_send_lc3(&data[offset], len);
                    offset += len;
                }
            }
        }
    }

    return 0;
}
```

## src/audio_buffer.c
```c
/*
 * Cervos — Shared Audio Ring Buffer Implementation
 */

#include "audio_buffer.h"
#include <string.h>
#include <errno.h>

/* Global instance */
audio_ring_buffer_t audio_ring_buffer;

void audio_buffer_init(audio_ring_buffer_t *buf)
{
    memset(buf->frames, 0, sizeof(buf->frames));
    buf->write_head = 0;
    buf->read_head = 0;
    k_sem_init(&buf->frame_ready, 0, AUDIO_BUFFER_FRAMES);
}

int audio_buffer_write(audio_ring_buffer_t *buf, const int16_t *pcm, size_t samples)
{
    if (samples != AUDIO_FRAME_SAMPLES) {
        return -EINVAL;
    }

    uint32_t idx = buf->write_head % AUDIO_BUFFER_FRAMES;
    int ret = 0;

    /* Check for overrun — if write catches up to read, we overwrite oldest */
    if (buf->write_head - buf->read_head >= AUDIO_BUFFER_FRAMES) {
        /* Buffer full — advance read head (drop oldest frame) */
        buf->read_head++;
        ret = -ENOSPC;
    }

    memcpy(buf->frames[idx], pcm, AUDIO_FRAME_BYTES);
    buf->write_head++;

    k_sem_give(&buf->frame_ready);

    return ret;
}

int audio_buffer_read(audio_ring_buffer_t *buf, int16_t *pcm_out, size_t samples)
{
    if (samples != AUDIO_FRAME_SAMPLES) {
        return -EINVAL;
    }

    if (buf->read_head >= buf->write_head) {
        return -ENODATA;
    }

    uint32_t idx = buf->read_head % AUDIO_BUFFER_FRAMES;
    memcpy(pcm_out, buf->frames[idx], AUDIO_FRAME_BYTES);
    buf->read_head++;

    return 0;
}

bool audio_buffer_has_data(audio_ring_buffer_t *buf)
{
    return buf->read_head < buf->write_head;
}

void audio_buffer_flush(audio_ring_buffer_t *buf)
{
    buf->read_head = buf->write_head;
    /* Drain semaphore without reinitializing it */
    while (k_sem_take(&buf->frame_ready, K_NO_WAIT) == 0) {
        /* discard */
    }
}
```

## src/audio_buffer.h
```c
/*
 * Cervos — Shared Audio Ring Buffer
 *
 * Audio: 48kHz, 16-bit PCM, stereo interleaved, 10ms frames
 * 480 samples/channel × 2 channels = 960 samples = 1920 bytes per frame
 */

#ifndef AUDIO_BUFFER_H
#define AUDIO_BUFFER_H

#include <zephyr/kernel.h>
#include <stdint.h>
#include <stdbool.h>

#define AUDIO_SAMPLE_RATE       24000
#define AUDIO_SAMPLE_BITS       16
#define AUDIO_CHANNELS          1
#define AUDIO_FRAME_MS          10
#define AUDIO_FRAME_SAMPLES     (AUDIO_SAMPLE_RATE * AUDIO_FRAME_MS / 1000 * AUDIO_CHANNELS)  /* 240 */
#define AUDIO_FRAME_BYTES       (AUDIO_FRAME_SAMPLES * (AUDIO_SAMPLE_BITS / 8))  /* 480 */
#define AUDIO_BUFFER_FRAMES     8

typedef struct {
    int16_t frames[AUDIO_BUFFER_FRAMES][AUDIO_FRAME_SAMPLES];
    volatile uint32_t write_head;
    volatile uint32_t read_head;
    struct k_sem frame_ready;
} audio_ring_buffer_t;

extern audio_ring_buffer_t audio_ring_buffer;

void audio_buffer_init(audio_ring_buffer_t *buf);
int  audio_buffer_write(audio_ring_buffer_t *buf, const int16_t *pcm, size_t samples);
int  audio_buffer_read(audio_ring_buffer_t *buf, int16_t *pcm_out, size_t samples);
bool audio_buffer_has_data(audio_ring_buffer_t *buf);
void audio_buffer_flush(audio_ring_buffer_t *buf);

#endif
```

## src/ble_audio_stream.c
```c
/*
 * Cervos — nRF52840 BLE Audio Stream
 *
 * BLE GATT service with:
 * - Audio stream characteristic (notify) — 24kHz mono PCM frames
 * - Capture control characteristic (write) — 0x00=off, 0x01=on
 */

#include <zephyr/kernel.h>
#include <zephyr/bluetooth/bluetooth.h>
#include <zephyr/bluetooth/conn.h>
#include <zephyr/bluetooth/gatt.h>
#include <zephyr/bluetooth/uuid.h>
#include <zephyr/usb/usb_device.h>
#include <zephyr/logging/log.h>

#include "audio_buffer.h"

LOG_MODULE_REGISTER(ble_audio, LOG_LEVEL_INF);

#define BT_UUID_CERVOS_AUDIO_VAL \
    BT_UUID_128_ENCODE(0xCE570500, 0x0001, 0x4000, 0x8000, 0x00805F9B34FB)
#define BT_UUID_CERVOS_AUDIO BT_UUID_DECLARE_128(BT_UUID_CERVOS_AUDIO_VAL)

#define BT_UUID_AUDIO_STREAM_VAL \
    BT_UUID_128_ENCODE(0xCE570500, 0x0002, 0x4000, 0x8000, 0x00805F9B34FB)
#define BT_UUID_AUDIO_STREAM BT_UUID_DECLARE_128(BT_UUID_AUDIO_STREAM_VAL)

#define BT_UUID_CAPTURE_CTRL_VAL \
    BT_UUID_128_ENCODE(0xCE570500, 0x0003, 0x4000, 0x8000, 0x00805F9B34FB)
#define BT_UUID_CAPTURE_CTRL BT_UUID_DECLARE_128(BT_UUID_CAPTURE_CTRL_VAL)

static struct bt_conn *current_conn;
static bool notify_enabled;
static uint8_t capture_enabled = 1;

static void ccc_cfg_changed(const struct bt_gatt_attr *attr, uint16_t value)
{
    notify_enabled = (value == BT_GATT_CCC_NOTIFY);
    LOG_INF("Audio notifications %s", notify_enabled ? "enabled" : "disabled");
}

static ssize_t read_capture_ctrl(struct bt_conn *conn,
                                  const struct bt_gatt_attr *attr,
                                  void *buf, uint16_t len, uint16_t offset)
{
    return bt_gatt_attr_read(conn, attr, buf, len, offset,
                             &capture_enabled, sizeof(capture_enabled));
}

static ssize_t write_capture_ctrl(struct bt_conn *conn,
                                   const struct bt_gatt_attr *attr,
                                   const void *buf, uint16_t len,
                                   uint16_t offset, uint8_t flags)
{
    if (len != 1) {
        return BT_GATT_ERR(BT_ATT_ERR_INVALID_ATTRIBUTE_LEN);
    }

    uint8_t val = *((const uint8_t *)buf);
    if (val > 1) {
        return BT_GATT_ERR(BT_ATT_ERR_VALUE_NOT_ALLOWED);
    }

    capture_enabled = val;

    if (capture_enabled) {
        usb_enable(NULL);
        LOG_INF("Capture ON — USB audio enabled");
    } else {
        usb_disable();
        LOG_INF("Capture OFF — USB audio released");
    }

    return len;
}

BT_GATT_SERVICE_DEFINE(cervos_audio_svc,
    BT_GATT_PRIMARY_SERVICE(BT_UUID_CERVOS_AUDIO),
    BT_GATT_CHARACTERISTIC(BT_UUID_AUDIO_STREAM,
        BT_GATT_CHRC_NOTIFY,
        BT_GATT_PERM_NONE,
        NULL, NULL, NULL),
    BT_GATT_CCC(ccc_cfg_changed,
        BT_GATT_PERM_READ | BT_GATT_PERM_WRITE),
    BT_GATT_CHARACTERISTIC(BT_UUID_CAPTURE_CTRL,
        BT_GATT_CHRC_READ | BT_GATT_CHRC_WRITE,
        BT_GATT_PERM_READ | BT_GATT_PERM_WRITE,
        read_capture_ctrl, write_capture_ctrl, &capture_enabled),
);

static void connected(struct bt_conn *conn, uint8_t err)
{
    if (err) {
        LOG_ERR("BLE connection failed (err %u)", err);
        return;
    }
    current_conn = bt_conn_ref(conn);
    LOG_INF("BLE connected");

    capture_enabled = 1;

    /* Flush stale audio from ring buffer */
    audio_buffer_flush(&audio_ring_buffer);

    struct bt_conn_le_data_len_param dl_param = {
        .tx_max_len = 251,
        .tx_max_time = 2120,
    };
    bt_conn_le_data_len_update(conn, &dl_param);

    /* Request fastest connection interval: 7.5ms */
    struct bt_le_conn_param conn_param = {
        .interval_min = 6,   /* 6 × 1.25ms = 7.5ms */
        .interval_max = 6,
        .latency = 0,
        .timeout = 400,      /* 4 seconds */
    };
    bt_conn_le_param_update(conn, &conn_param);
}

static void disconnected(struct bt_conn *conn, uint8_t reason)
{
    LOG_INF("BLE disconnected (reason %u)", reason);
    if (current_conn) {
        bt_conn_unref(current_conn);
        current_conn = NULL;
    }
    notify_enabled = false;
    capture_enabled = 0;
}

BT_CONN_CB_DEFINE(conn_callbacks) = {
    .connected = connected,
    .disconnected = disconnected,
};

int ble_audio_send_frame(const int16_t *pcm_data, size_t samples)
{
    (void)pcm_data;
    (void)samples;
    return -ENOTSUP;  /* Unused — replaced by ble_audio_send_opus */
}

int ble_audio_send_opus(const uint8_t *data, size_t len)
{
    if (!current_conn || !capture_enabled) {
        return -ENOTCONN;
    }

    /* Opus packets are typically 40-300 bytes — fits in one BLE notification */
    return bt_gatt_notify(current_conn,
                          &cervos_audio_svc.attrs[2],
                          data, len);
}

static const struct bt_data ad[] = {
    BT_DATA_BYTES(BT_DATA_FLAGS, (BT_LE_AD_GENERAL | BT_LE_AD_NO_BREDR)),
    BT_DATA_BYTES(BT_DATA_UUID128_ALL, BT_UUID_CERVOS_AUDIO_VAL),
};

static const struct bt_data sd[] = {
    BT_DATA(BT_DATA_NAME_COMPLETE, CONFIG_BT_DEVICE_NAME,
            sizeof(CONFIG_BT_DEVICE_NAME) - 1),
};

int ble_audio_init(void)
{
    int ret;

    ret = bt_enable(NULL);
    if (ret) {
        LOG_ERR("Bluetooth init failed: %d", ret);
        return ret;
    }

    ret = bt_le_adv_start(BT_LE_ADV_CONN, ad, ARRAY_SIZE(ad), sd, ARRAY_SIZE(sd));
    if (ret) {
        LOG_ERR("Advertising start failed: %d", ret);
        return ret;
    }

    LOG_INF("BLE advertising as \"%s\"", CONFIG_BT_DEVICE_NAME);
    return 0;
}
```

## src/ble_l2cap_stream.c
```c
/*
 * Cervos — BLE Audio Transport
 *
 * GATT notification-based audio streaming with LC3 codec.
 * Each notification carries one packet:
 *   [seq_num:u16][timestamp:u32][frame_count:u8][LC3 frame]
 *
 * LC3 stereo frame = 200 bytes + 7 byte header = 207 bytes.
 * Fits in a single GATT notification with DLE (max 244 bytes payload).
 *
 * Also maintains GATT characteristics for config (capture control,
 * dongle name, power mode).
 */

#include <zephyr/kernel.h>
#include <zephyr/bluetooth/bluetooth.h>
#include <zephyr/bluetooth/conn.h>
#include <zephyr/bluetooth/gatt.h>
#include <zephyr/bluetooth/uuid.h>
#include <zephyr/usb/usb_device.h>
#include <zephyr/settings/settings.h>
#include <zephyr/sys/reboot.h>
#include <zephyr/sys/byteorder.h>
#include <zephyr/logging/log.h>
#include <string.h>

#include "audio_buffer.h"
#include "lc3_encoder.h"

LOG_MODULE_REGISTER(ble_audio, LOG_LEVEL_INF);

/* ---- Packet header ---- */
#define PKT_HEADER_SIZE  7  /* u16 seq + u32 timestamp + u8 frame_count */

/* ---- GATT UUIDs ---- */
#define BT_UUID_CERVOS_AUDIO_VAL \
    BT_UUID_128_ENCODE(0xCE570500, 0x0001, 0x4000, 0x8000, 0x00805F9B34FB)
#define BT_UUID_CERVOS_AUDIO BT_UUID_DECLARE_128(BT_UUID_CERVOS_AUDIO_VAL)

#define BT_UUID_AUDIO_STREAM_VAL \
    BT_UUID_128_ENCODE(0xCE570500, 0x0002, 0x4000, 0x8000, 0x00805F9B34FB)
#define BT_UUID_AUDIO_STREAM BT_UUID_DECLARE_128(BT_UUID_AUDIO_STREAM_VAL)

#define BT_UUID_CAPTURE_CTRL_VAL \
    BT_UUID_128_ENCODE(0xCE570500, 0x0003, 0x4000, 0x8000, 0x00805F9B34FB)
#define BT_UUID_CAPTURE_CTRL BT_UUID_DECLARE_128(BT_UUID_CAPTURE_CTRL_VAL)

#define BT_UUID_DONGLE_CONFIG_VAL \
    BT_UUID_128_ENCODE(0xCE570500, 0xCF01, 0x4000, 0x8000, 0x00805F9B34FB)
#define BT_UUID_DONGLE_CONFIG BT_UUID_DECLARE_128(BT_UUID_DONGLE_CONFIG_VAL)

#define BT_UUID_POWER_MODE_VAL \
    BT_UUID_128_ENCODE(0xCE570500, 0xCF02, 0x4000, 0x8000, 0x00805F9B34FB)
#define BT_UUID_POWER_MODE BT_UUID_DECLARE_128(BT_UUID_POWER_MODE_VAL)

/* ---- State ---- */
static struct bt_conn *current_conn;
static bool notify_enabled;
static uint8_t capture_enabled = 1;
static uint8_t active_power_mode = 1;  /* Balanced */

/* Sequence counter and timestamp */
static uint16_t seq_num;
static uint32_t frame_timestamp;

/* ---- GATT: CCC changed ---- */

static void ccc_cfg_changed(const struct bt_gatt_attr *attr, uint16_t value)
{
    notify_enabled = (value == BT_GATT_CCC_NOTIFY);
    LOG_INF("Audio notifications %s", notify_enabled ? "enabled" : "disabled");
}

/* ---- GATT: capture control ---- */

static ssize_t read_capture_ctrl(struct bt_conn *conn,
                                  const struct bt_gatt_attr *attr,
                                  void *buf, uint16_t len, uint16_t offset)
{
    return bt_gatt_attr_read(conn, attr, buf, len, offset,
                             &capture_enabled, sizeof(capture_enabled));
}

static ssize_t write_capture_ctrl(struct bt_conn *conn,
                                   const struct bt_gatt_attr *attr,
                                   const void *buf, uint16_t len,
                                   uint16_t offset, uint8_t flags)
{
    if (len != 1) return BT_GATT_ERR(BT_ATT_ERR_INVALID_ATTRIBUTE_LEN);
    uint8_t val = *((const uint8_t *)buf);
    if (val > 1) return BT_GATT_ERR(BT_ATT_ERR_VALUE_NOT_ALLOWED);
    capture_enabled = val;
    if (capture_enabled) {
        usb_enable(NULL);
        LOG_INF("Capture ON");
    } else {
        usb_disable();
        LOG_INF("Capture OFF");
    }
    return len;
}

/* ---- GATT: dongle name config (0xCF01) ---- */

static char dongle_name[33] = CONFIG_BT_DEVICE_NAME;

static ssize_t read_dongle_name(struct bt_conn *conn,
                                 const struct bt_gatt_attr *attr,
                                 void *buf, uint16_t len, uint16_t offset)
{
    return bt_gatt_attr_read(conn, attr, buf, len, offset,
                             dongle_name, strlen(dongle_name));
}

static ssize_t write_dongle_name(struct bt_conn *conn,
                                  const struct bt_gatt_attr *attr,
                                  const void *buf, uint16_t len,
                                  uint16_t offset, uint8_t flags)
{
    if (len == 0 || len > 32) return BT_GATT_ERR(BT_ATT_ERR_INVALID_ATTRIBUTE_LEN);
    memcpy(dongle_name, buf, len);
    dongle_name[len] = '\0';
    settings_save_one("cervos/name", dongle_name, len + 1);
    LOG_INF("Name set to \"%s\" — rebooting", dongle_name);
    k_sleep(K_MSEC(100));
    sys_reboot(SYS_REBOOT_WARM);
    return len;
}

/* ---- GATT: power mode (0xCF02) ---- */

static ssize_t read_power_mode(struct bt_conn *conn,
                                const struct bt_gatt_attr *attr,
                                void *buf, uint16_t len, uint16_t offset)
{
    return bt_gatt_attr_read(conn, attr, buf, len, offset,
                             &active_power_mode, sizeof(active_power_mode));
}

static ssize_t write_power_mode(struct bt_conn *conn,
                                 const struct bt_gatt_attr *attr,
                                 const void *buf, uint16_t len,
                                 uint16_t offset, uint8_t flags)
{
    if (len != 1) return BT_GATT_ERR(BT_ATT_ERR_INVALID_ATTRIBUTE_LEN);
    uint8_t val = *((const uint8_t *)buf);
    if (val > 2) return BT_GATT_ERR(BT_ATT_ERR_VALUE_NOT_ALLOWED);
    active_power_mode = val;
    settings_save_one("cervos/power_mode", &active_power_mode, 1);
    LOG_INF("Power mode set to %d", active_power_mode);
    return len;
}

/* ---- NVS settings ---- */

static int settings_set(const char *name, size_t len,
                         settings_read_cb read_cb, void *cb_arg)
{
    if (!strcmp(name, "name")) {
        int rc = read_cb(cb_arg, dongle_name, sizeof(dongle_name) - 1);
        if (rc > 0) dongle_name[rc] = '\0';
        return 0;
    }
    if (!strcmp(name, "power_mode")) {
        int rc = read_cb(cb_arg, &active_power_mode, 1);
        if (rc == 1 && active_power_mode > 2) active_power_mode = 1;
        return 0;
    }
    return -ENOENT;
}

SETTINGS_STATIC_HANDLER_DEFINE(cervos, "cervos", NULL, settings_set, NULL, NULL);

/* ---- GATT service definition ---- */

BT_GATT_SERVICE_DEFINE(cervos_audio_svc,
    BT_GATT_PRIMARY_SERVICE(BT_UUID_CERVOS_AUDIO),

    /* Audio stream: notify */
    BT_GATT_CHARACTERISTIC(BT_UUID_AUDIO_STREAM,
        BT_GATT_CHRC_NOTIFY,
        BT_GATT_PERM_NONE,
        NULL, NULL, NULL),
    BT_GATT_CCC(ccc_cfg_changed,
        BT_GATT_PERM_READ | BT_GATT_PERM_WRITE),

    /* Capture control: read/write */
    BT_GATT_CHARACTERISTIC(BT_UUID_CAPTURE_CTRL,
        BT_GATT_CHRC_READ | BT_GATT_CHRC_WRITE,
        BT_GATT_PERM_READ | BT_GATT_PERM_WRITE,
        read_capture_ctrl, write_capture_ctrl, &capture_enabled),

    /* Dongle name: read/write */
    BT_GATT_CHARACTERISTIC(BT_UUID_DONGLE_CONFIG,
        BT_GATT_CHRC_READ | BT_GATT_CHRC_WRITE,
        BT_GATT_PERM_READ | BT_GATT_PERM_WRITE,
        read_dongle_name, write_dongle_name, NULL),

    /* Power mode: read/write */
    BT_GATT_CHARACTERISTIC(BT_UUID_POWER_MODE,
        BT_GATT_CHRC_READ | BT_GATT_CHRC_WRITE,
        BT_GATT_PERM_READ | BT_GATT_PERM_WRITE,
        read_power_mode, write_power_mode, &active_power_mode),
);

/* ---- BLE connection callbacks ---- */

static void connected(struct bt_conn *conn, uint8_t err)
{
    if (err) {
        LOG_ERR("BLE connection failed (err %u)", err);
        return;
    }
    current_conn = bt_conn_ref(conn);
    LOG_INF("BLE connected");

    capture_enabled = 1;
    seq_num = 0;
    frame_timestamp = 0;

    audio_buffer_flush(&audio_ring_buffer);

    /* Request DLE for larger notifications */
    struct bt_conn_le_data_len_param dl_param = {
        .tx_max_len = 251,
        .tx_max_time = 2120,
    };
    bt_conn_le_data_len_update(conn, &dl_param);

    /* Request fastest connection interval: 7.5ms */
    struct bt_le_conn_param conn_param = {
        .interval_min = 6,   /* 6 × 1.25ms = 7.5ms */
        .interval_max = 6,
        .latency = 0,
        .timeout = 400,
    };
    bt_conn_le_param_update(conn, &conn_param);
}

static void disconnected(struct bt_conn *conn, uint8_t reason)
{
    LOG_INF("BLE disconnected (reason %u)", reason);
    if (current_conn) {
        bt_conn_unref(current_conn);
        current_conn = NULL;
    }
    notify_enabled = false;
    capture_enabled = 0;
}

BT_CONN_CB_DEFINE(conn_callbacks) = {
    .connected = connected,
    .disconnected = disconnected,
};

/* ---- Audio send over GATT notify ---- */

/* Send raw data as GATT notification — no header wrapping */
int ble_audio_send_lc3(const uint8_t *data, size_t len)
{
    if (!current_conn || !notify_enabled || !capture_enabled) {
        return -ENOTCONN;
    }

    return bt_gatt_notify(current_conn,
                          &cervos_audio_svc.attrs[2],
                          data, len);
}

bool ble_audio_is_mono_fallback(void)
{
    return false;  /* No RSSI monitoring in GATT mode */
}

/* ---- BLE advertising ---- */

static const struct bt_data ad[] = {
    BT_DATA_BYTES(BT_DATA_FLAGS, (BT_LE_AD_GENERAL | BT_LE_AD_NO_BREDR)),
    BT_DATA_BYTES(BT_DATA_UUID128_ALL, BT_UUID_CERVOS_AUDIO_VAL),
};

static const struct bt_data sd[] = {
    BT_DATA(BT_DATA_NAME_COMPLETE, CONFIG_BT_DEVICE_NAME,
            sizeof(CONFIG_BT_DEVICE_NAME) - 1),
};

int ble_audio_init(void)
{
    int ret;

    /* Load saved settings — non-fatal */
    int settings_err = settings_subsys_init();
    if (settings_err) {
        LOG_WRN("Settings init failed: %d — using defaults", settings_err);
    } else {
        settings_load();
    }

    ret = bt_enable(NULL);
    if (ret) {
        LOG_ERR("Bluetooth init failed: %d", ret);
        return ret;
    }

    ret = bt_le_adv_start(BT_LE_ADV_CONN, ad, ARRAY_SIZE(ad), sd, ARRAY_SIZE(sd));
    if (ret) {
        LOG_ERR("Advertising start failed: %d", ret);
        return ret;
    }

    LOG_INF("BLE advertising as \"%s\" — GATT notify transport", dongle_name);
    return 0;
}
```

## src/ble_sniffer.c
```c
/*
 * Cervos — nRF52840 BLE Sniffer
 *
 * Development mode: BLE protocol sniffer for reverse-engineering
 * the Even Realities G2 and R1 ring GATT protocols.
 *
 * Not used during normal operation — only for protocol development.
 *
 * Platform: Zephyr RTOS
 */

#include <zephyr/kernel.h>
#include <zephyr/bluetooth/bluetooth.h>
#include <zephyr/bluetooth/hci.h>

/* TODO: Implement BLE sniffer for G2/R1 protocol reverse-engineering */
```

## src/lc3_encoder.c
```c
/*
 * Cervos — LC3 Encoder for nRF52840
 *
 * Single encoder instance for 24kHz mono.
 */

#include <zephyr/kernel.h>
#include <zephyr/logging/log.h>
#include <string.h>

#include "lc3.h"
#include "lc3_encoder.h"

LOG_MODULE_REGISTER(lc3_enc, LOG_LEVEL_INF);

#define LC3_ENC_MEM_SIZE  24576

static uint8_t enc_mem[LC3_ENC_MEM_SIZE] __attribute__((aligned(8)));
static lc3_encoder_t enc;
static bool initialized;

int lc3_enc_init(void)
{
    unsigned needed = lc3_encoder_size(LC3_FRAME_US, LC3_SAMPLE_RATE);
    LOG_INF("LC3 encoder needs %u bytes, allocated %u", needed, LC3_ENC_MEM_SIZE);

    if (needed > LC3_ENC_MEM_SIZE) {
        LOG_ERR("LC3 encoder memory too small");
        return -1;
    }

    enc = lc3_setup_encoder(LC3_FRAME_US, LC3_SAMPLE_RATE, 0, enc_mem);
    if (!enc) {
        LOG_ERR("LC3 encoder setup failed");
        return -1;
    }

    initialized = true;
    LOG_INF("LC3 encoder ready — %dHz mono 10ms %dkbps (%d bytes/frame)",
            LC3_SAMPLE_RATE, LC3_BITRATE / 1000, LC3_FRAME_BYTES);
    return 0;
}

int lc3_enc_encode(const int16_t *pcm_input, uint8_t *output, int output_max)
{
    if (!initialized || output_max < LC3_FRAME_BYTES) {
        return -1;
    }

    int err = lc3_encode(enc, LC3_PCM_FORMAT_S16, pcm_input, 1,
                         LC3_FRAME_BYTES, output);
    if (err) {
        return -1;
    }
    return LC3_FRAME_BYTES;
}
```

## src/lc3_encoder.h
```c
/*
 * Cervos — LC3 Encoder for nRF52840
 *
 * Encodes 24kHz mono PCM → LC3 compressed frames for BLE transmission.
 * 24kHz, mono, 10ms frames, ~48kbps → ~60 bytes per frame.
 */

#ifndef LC3_ENCODER_H
#define LC3_ENCODER_H

#include <stdint.h>
#include <stdbool.h>

#define LC3_SAMPLE_RATE     24000
#define LC3_CHANNELS        1
#define LC3_FRAME_US        10000   /* 10ms */
#define LC3_FRAME_SAMPLES   (LC3_SAMPLE_RATE / 100)  /* 240 per channel */
#define LC3_BITRATE         48000   /* 48kbps mono */
#define LC3_FRAME_BYTES     (LC3_BITRATE / 8 / 100)  /* 60 bytes per frame */
#define LC3_MAX_PACKET      128

int lc3_enc_init(void);
int lc3_enc_encode(const int16_t *pcm_input, uint8_t *output, int output_max);

#endif
```

## src/opus_encoder_wrapper.c
```c
/*
 * Cervos — Opus Encoder Wrapper for nRF52840
 */

#include <zephyr/kernel.h>
#include <zephyr/logging/log.h>
#include <string.h>

#include "opus.h"
#include "opus_encoder_wrapper.h"

LOG_MODULE_REGISTER(opus_enc, LOG_LEVEL_INF);

/* Static encoder memory — avoids malloc on embedded */
static uint8_t encoder_mem[16384] __attribute__((aligned(4)));  /* 16KB — mono encoder */
static OpusEncoder *encoder = (OpusEncoder *)encoder_mem;

int opus_enc_init(void)
{
    int err;
    int size = opus_encoder_get_size(OPUS_CHANNELS);
    LOG_INF("Opus encoder needs %d bytes, allocated %d", size, sizeof(encoder_mem));

    if (size > (int)sizeof(encoder_mem)) {
        LOG_ERR("Opus encoder memory too small!");
        return -1;
    }

    err = opus_encoder_init(encoder, OPUS_SAMPLE_RATE, OPUS_CHANNELS,
                            OPUS_APPLICATION_RESTRICTED_LOWDELAY);
    if (err != OPUS_OK) {
        LOG_ERR("Opus encoder init failed: %d", err);
        return err;
    }

    opus_encoder_ctl(encoder, OPUS_SET_BITRATE(OPUS_BITRATE));
    opus_encoder_ctl(encoder, OPUS_SET_COMPLEXITY(1));  /* 1 = fastest encoding for embedded */
    opus_encoder_ctl(encoder, OPUS_SET_VBR(0));         /* CBR = predictable timing */
    opus_encoder_ctl(encoder, OPUS_SET_SIGNAL(OPUS_SIGNAL_MUSIC));
    opus_encoder_ctl(encoder, OPUS_SET_EXPERT_FRAME_DURATION(OPUS_FRAMESIZE_20_MS));

    LOG_INF("Opus encoder ready — %dHz %dch %dkbps %dms frames",
            OPUS_SAMPLE_RATE, OPUS_CHANNELS, OPUS_BITRATE / 1000, OPUS_FRAME_MS);
    return 0;
}

int opus_enc_encode(const int16_t *pcm_input, uint8_t *output, int output_max)
{
    return opus_encode(encoder, pcm_input, OPUS_FRAME_SAMPLES, output, output_max);
}
```

## src/opus_encoder_wrapper.h
```c
/*
 * Cervos — Opus Encoder Wrapper for nRF52840
 *
 * Encodes 48kHz stereo PCM → Opus compressed frames for BLE transmission.
 */

#ifndef OPUS_ENCODER_WRAPPER_H
#define OPUS_ENCODER_WRAPPER_H

#include <stdint.h>

/* Opus encoding parameters */
#define OPUS_SAMPLE_RATE    24000
#define OPUS_CHANNELS       1       /* Mono — halves encoding CPU */
#define OPUS_FRAME_MS       20      /* 20ms frames — best Opus efficiency */
#define OPUS_FRAME_SAMPLES  (OPUS_SAMPLE_RATE * OPUS_FRAME_MS / 1000)  /* 960 per channel */
#define OPUS_BITRATE        96000   /* 96kbps — fits in single BLE notification */
#define OPUS_MAX_PACKET     512     /* Max encoded frame bytes */

/* Initialize Opus encoder. Returns 0 on success. */
int opus_enc_init(void);

/* Encode one frame of interleaved stereo PCM.
 * pcm_input: 960 interleaved stereo samples (1920 int16_t values)
 * output: compressed Opus packet
 * output_max: max bytes in output buffer
 * Returns: encoded packet size in bytes, or negative on error. */
int opus_enc_encode(const int16_t *pcm_input, uint8_t *output, int output_max);

#endif
```

## src/usb_audio_capture.c
```c
/*
 * Cervos — nRF52840 USB Audio Capture
 *
 * Receives 48kHz stereo 16-bit PCM from work PC via USB Audio Class.
 * Downsamples to 24kHz mono and accumulates into 20ms frames (480 samples)
 * for the shared ring buffer.
 */

#include <zephyr/kernel.h>
#include <zephyr/device.h>
#include <zephyr/usb/usb_device.h>
#include <zephyr/usb/class/usb_audio.h>
#include <zephyr/logging/log.h>
#include <string.h>

#include "audio_buffer.h"

LOG_MODULE_REGISTER(cervos_usb, LOG_LEVEL_INF);

static int16_t accum_buf[AUDIO_FRAME_SAMPLES];
static uint32_t accum_pos = 0;
static uint32_t ds_counter = 0;

#define DOWNSAMPLE_RATIO 2  /* 48kHz → 24kHz */

static void usb_audio_data_recv_cb(const struct device *dev,
                                    struct net_buf *buffer,
                                    size_t size)
{
    if (!buffer || size == 0) {
        return;
    }

    const int16_t *samples = (const int16_t *)buffer->data;
    size_t total_samples = size / sizeof(int16_t);

    /* Mix stereo to mono + downsample 2:1 */
    for (size_t i = 0; i + 1 < total_samples; i += 2) {
        if (ds_counter % DOWNSAMPLE_RATIO == 0) {
            int16_t mono = (int16_t)(((int32_t)samples[i] + samples[i + 1]) / 2);
            accum_buf[accum_pos++] = mono;
        }
        ds_counter++;

        if (accum_pos >= AUDIO_FRAME_SAMPLES) {
            audio_buffer_write(&audio_ring_buffer, accum_buf, AUDIO_FRAME_SAMPLES);
            accum_pos = 0;
        }
    }

    net_buf_unref(buffer);
}

static const struct usb_audio_ops audio_ops = {
    .data_received_cb = usb_audio_data_recv_cb,
};

int usb_audio_init(void)
{
    int ret;
    const struct device *usb_audio_dev;

    accum_pos = 0;
    memset(accum_buf, 0, sizeof(accum_buf));

    usb_audio_dev = DEVICE_DT_GET_ONE(usb_audio_hp);
    if (!device_is_ready(usb_audio_dev)) {
        LOG_ERR("USB audio device not ready");
        return -ENODEV;
    }

    usb_audio_register(usb_audio_dev, &audio_ops);

    ret = usb_enable(NULL);
    if (ret != 0) {
        LOG_ERR("Failed to enable USB: %d", ret);
        return ret;
    }

    LOG_INF("USB Audio initialized — 48kHz stereo → 24kHz mono");
    return 0;
}
```
